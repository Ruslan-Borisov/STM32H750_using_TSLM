/**
  ******************************************************************************
  * @file    uart_use.c
  * @author  Борисов Руслан
  * @brief   Реализация модуля отладки через UART (блокирующий режим)
  * @date    15.03.2026
  *
  * @details Этот файл содержит реализацию функций для отладки через UART
  *          в блокирующем режиме. Предоставляет форматированный вывод (printf),
  *          отправку строк и бинарных данных. Все функции синхронные с таймаутом.
  *
  * @note    Предназначен для использования с TensorFlow Lite Micro и STM32 HAL
  * @warning Блокирующие функции могут влиять на производительность в реальном времени
  ******************************************************************************
  */

/*============================================================================
 *                               ВКЛЮЧАЕМЫЕ ФАЙЛЫ
 *============================================================================*/

/* ============== Свой заголовок ============== */
#include "uart_use.h"

/* ============== HAL (обернут для C++) ============== */
extern "C" {
#include "usart.h"
}

/* ============== Стандартные заголовки ============== */
#include <stdio.h>
#include <string.h>
#include <stdarg.h>

/*============================================================================
 *                              ЛОКАЛЬНЫЕ КОНСТАНТЫ
 *============================================================================*/

/**
 * @defgroup UART_LocalConstants Локальные константы UART
 * @{
 */
#define DEBUG_TIMEOUT           1000    /**< Таймаут для блокирующей отправки в мс */
#define TX_BUFFER_SIZE_LOCAL    1000    /**< Размер буфера передачи (локальный алиас) */
/** @} */

/*============================================================================
 *                              ГЛОБАЛЬНЫЕ ПЕРЕМЕННЫЕ
 *============================================================================*/

/**
 * @brief   Указатель на структуру UART для отладки
 * @details По умолчанию указывает на huart1. Может быть изменен пользователем
 *          перед вызовом Debug_Init() для использования другого UART.
 * 
 * @note    Должен быть инициализирован до вызова функций отладки
 */
UART_HandleTypeDef *debug_uart = &huart1;

/**
 * @brief   Локальный буфер для форматирования строк
 * @details Используется функциями Debug_Printf и Debug_PrintLine для
 *          временного хранения форматированной строки перед отправкой.
 * 
 * @note    Размер буфера должен быть достаточным для максимальной строки
 */
static char local_buffer[TX_BUFFER_SIZE];

/*============================================================================
 *                      РЕАЛИЗАЦИЯ ПУБЛИЧНЫХ ФУНКЦИЙ
 *============================================================================*/

/**
 * @brief   Инициализация отладки через UART
 * @details Выполняет начальную задержку и отправляет приветственное сообщение
 * 
 * @note    Должна быть вызвана один раз после инициализации UART в HAL
 * @note    Отправляет "\r\nSystem initialized with direct UART (no DMA)\r\n"
 */
void Debug_Init(void)
{
    /* Небольшая задержка для стабилизации UART */
    HAL_Delay(10);
    
    /* Отправляем приветственное сообщение */
    Debug_Printf("\r\n");
    Debug_Printf("System initialized with direct UART (no DMA)\r\n");
}

/**
 * @brief   Форматированный вывод в UART (аналог printf)
 * @param   format  Строка формата (поддерживает все спецификаторы стандартного printf)
 * @param   ...     Переменное количество аргументов для форматирования
 * 
 * @return  int     Количество записанных байт, или -1 при ошибке
 * 
 * @note    Блокирующая функция - ожидает завершения передачи до DEBUG_TIMEOUT мс
 * @note    Использует внутренний буфер размером TX_BUFFER_SIZE
 * 
 * @warning Если строка длиннее TX_BUFFER_SIZE, она будет обрезана
 */
int Debug_Printf(const char *format, ...)
{
    int len;
    va_list args;
    HAL_StatusTypeDef status;

    /* Проверка входных параметров */
    if (format == NULL)
        return -1;

    /* Форматируем строку в локальный буфер */
    va_start(args, format);
    len = vsnprintf(local_buffer, TX_BUFFER_SIZE - 1, format, args);
    va_end(args);

    /* Проверка результата форматирования */
    if (len <= 0)
        return len;

    /* Обрезка строки при переполнении буфера */
    if (len >= TX_BUFFER_SIZE)
        len = TX_BUFFER_SIZE - 1;

    local_buffer[len] = '\0';

    /* БЛОКИРУЮЩАЯ отправка через UART */
    status = HAL_UART_Transmit(debug_uart, (uint8_t*)local_buffer, len, DEBUG_TIMEOUT);
    
    return (status == HAL_OK) ? len : -1;
}

/**
 * @brief   Вывод строки с добавлением символов новой строки (\r\n)
 * @param   str     Указатель на нуль-терминированную строку для вывода
 * 
 * @return  int     1 - успешно, 0 - ошибка
 * 
 * @note    Автоматически добавляет \r\n в конец строки
 * @note    Блокирующая функция - ожидает завершения передачи
 * @warning При переполнении буфера строка обрезается
 */
int Debug_PrintLine(const char* str)
{
    int len;
    HAL_StatusTypeDef status;

    /* Проверка входных параметров */
    if (str == NULL)
        return 0;

    /* Получаем длину строки */
    len = strlen(str);

    /* Проверяем, поместится ли с \r\n */
    if (len > TX_BUFFER_SIZE - 3)
        len = TX_BUFFER_SIZE - 3;

    /* Формируем строку с \r\n в локальном буфере */
    memcpy(local_buffer, str, len);
    local_buffer[len] = '\r';
    local_buffer[len + 1] = '\n';
    local_buffer[len + 2] = '\0';

    /* БЛОКИРУЮЩАЯ отправка через UART */
    status = HAL_UART_Transmit(debug_uart, (uint8_t*)local_buffer, len + 2, DEBUG_TIMEOUT);
    
    return (status == HAL_OK) ? 1 : 0;
}

/**
 * @brief   Отправка бинарных данных через UART
 * @param   data    Указатель на буфер с данными
 * @param   len     Количество байт для отправки
 * 
 * @return  int     1 - успешно, 0 - ошибка
 * 
 * @note    Блокирующая функция - ожидает завершения передачи
 * @note    Данные отправляются как есть, без добавления \r\n
 * @warning Максимальная длина данных не должна превышать TX_BUFFER_SIZE
 */
int Debug_SendData(const uint8_t* data, uint16_t len)
{
    HAL_StatusTypeDef status;

    /* Проверка входных параметров */
    if (data == NULL || len == 0 || len >= TX_BUFFER_SIZE)
        return 0;

    /* БЛОКИРУЮЩАЯ отправка через UART */
    status = HAL_UART_Transmit(debug_uart, (uint8_t*)data, len, DEBUG_TIMEOUT);
    
    return (status == HAL_OK) ? 1 : 0;
}

/**
 * @brief   Логирование строки (для совместимости с TensorFlow)
 * @param   str     Указатель на нуль-терминированную строку
 * 
 * @note    Функция-обертка для совместимости с интерфейсами TensorFlow Lite Micro
 * @note    Вызывает Debug_PrintLine(str)
 */
void Debug_LogString(const char* str)
{
    Debug_PrintLine(str);
}

/**
 * @brief   Ожидание завершения всех передач (для совместимости)
 * @details В блокирующем режиме функция не выполняет никаких действий,
 *          так как каждая передача завершается синхронно.
 * 
 * @note    Оставлена для совместимости с кодом, использующим DMA
 */
void Debug_Flush(void)
{
    /* Для блокирующей UART ничего делать не нужно */
    /* Функция оставлена для совместимости с кодом */
}

/**
 * @brief   Проверка готовности UART к отправке
 * @return  int     Всегда возвращает 1 (в блокирующем режиме)
 * 
 * @note    В блокирующем режиме UART всегда готов к отправке,
 *         так как функция HAL_UART_Transmit сама ожидает готовности
 */
int Debug_IsReady(void)
{
    return 1; /* Всегда готов, так как отправка блокирующая */
}

/**
 * @brief   Сброс состояния отладки (для совместимости)
 * @note    Не выполняет никаких действий в блокирующем режиме
 */
void Debug_Reset(void)
{
    /* Ничего не делаем */
}

/**
 * @brief   Вывод диагностической информации о состоянии UART
 * @details Выводит строку "Direct UART mode (blocking)\r\n"
 * 
 * @note    Полезна для отладки и проверки режима работы
 */
void Debug_BufferStatus(void)
{
    Debug_Printf("Direct UART mode (blocking)\r\n");
}

/**
 * @brief   Принудительная отправка данных (алиас для Debug_Flush)
 * @note    Добавлен для совместимости с некоторыми библиотеками
 */
//void Debug_FlushAndWait(void)
//{
//    Debug_Flush();
//}

/*============================================================================
 *                      ПРИМЕРЫ ИСПОЛЬЗОВАНИЯ
 *============================================================================*/

/**
 * @example uart_use_example.c
 * 
 * Пример использования модуля uart_use:
 * 
 * @code
 * #include "uart_use.h"
 * 
 * void main(void) {
 *     // Инициализация HAL и UART...
 *     
 *     // Инициализация отладки
 *     Debug_Init();
 *     
 *     // Простой вывод
 *     Debug_Printf("Hello World!\r\n");
 *     
 *     // Форматированный вывод
 *     int value = 42;
 *     Debug_Printf("Value: %d (0x%X)\r\n", value, value);
 *     
 *     // Вывод строки с переносом
 *     Debug_PrintLine("This line will have CRLF");
 *     
 *     // Отправка бинарных данных
 *     uint8_t data[] = {0x01, 0x02, 0x03, 0x04};
 *     Debug_SendData(data, sizeof(data));
 * }
 * @endcode
 */

/************************ (C) COPYRIGHT Борисов Руслан *****END OF FILE****/