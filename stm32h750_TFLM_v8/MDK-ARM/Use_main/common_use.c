/**
  ******************************************************************************
  * @file    use_main.c
  * @author  Борисов Руслан
  * @brief   Реализация основной логики приложения
  * @date    15.03.2026
  *
  * @details Этот файл содержит реализацию функций для работы с камерой,
  *          отображения на LCD, обработки прерываний и управления режимами
  *          приложения. Реализует Ping-Pong буферизацию для захвата видео
  *          с камеры OV2640.
  ******************************************************************************
  */

/*============================================================================
 *                               ВКЛЮЧАЕМЫЕ ФАЙЛЫ
 *============================================================================*/
#include "use_main.h"
#include <string.h>
#include <stdio.h>

/*============================================================================
 *                      ГЛОБАЛЬНЫЕ ПЕРЕМЕННЫЕ
 *============================================================================*/

/**
  * @name   Буферы кадров
  * @brief  Двойная буферизация для захвата изображения с камеры
  * @note   Размещены в AXI SRAM (512KB) через секцию .sram
  */
__attribute__((section(".sram"))) 
uint16_t pic[2][FrameHeight][FrameWidth];  /*!< Два буфера для Ping-Pong режима */

/**
  * @name   Буфер конвертации
  * @brief  Для преобразования форматов изображения
  * @note   Размещен в AXI SRAM
  */
__attribute__((section(".sram"))) 
uint16_t converted[LCD_WIDTH * 60];

/*============================================================================
 *                      УПРАВЛЕНИЕ БУФЕРАМИ
 *============================================================================*/
volatile uint32_t active_buffer = 0;    /*!< Активный буфер для захвата */
volatile uint32_t ready_buffer = 1;     /*!< Готовый буфер для обработки */

/*============================================================================
 *                      ФЛАГИ И СЧЕТЧИКИ КАМЕРЫ
 *============================================================================*/
volatile uint32_t DCMI_FrameIsReady = 0;    /*!< Флаг готовности кадра */
volatile uint32_t Camera_FPS = 0;           /*!< Текущий FPS камеры */
volatile uint32_t LastFPSUpdate = 0;        /*!< Время последнего обновления FPS */

/*============================================================================
 *                      ДИАГНОСТИЧЕСКИЕ СЧЕТЧИКИ
 *============================================================================*/
volatile uint32_t irq_counter = 0;      /*!< Счетчик прерываний */
volatile uint32_t display_counter = 0;  /*!< Счетчик обновлений дисплея */
volatile uint32_t error_counter = 0;    /*!< Счетчик ошибок */
volatile uint32_t last_irq_value = 0;   /*!< Последнее значение IRQ для отладки */

/*============================================================================
 *                      БУФЕРЫ ДЛЯ ТЕКСТА
 *============================================================================*/
uint8_t debug_text[50];  /*!< Буфер для отладочного текста */
uint8_t line1[30];       /*!< Буфер для первой строки дисплея */
uint8_t line2[30];       /*!< Буфер для второй строки дисплея */
uint8_t line3[30];       /*!< Буфер для третьей строки дисплея */
uint8_t line4[30];       /*!< Буфер для четвертой строки дисплея */

/*============================================================================
 *                      СЧЕТЧИКИ ЦИКЛОВ
 *============================================================================*/
uint32_t loop_counter = 0;          /*!< Счетчик основного цикла */
uint32_t last_display_update = 0;   /*!< Время последнего обновления дисплея */
uint32_t frame_counter = 0;         /*!< Счетчик кадров */
uint32_t inference_counter = 0;     /*!< Счетчик инференсов */

/*============================================================================
 *                      ПЕРЕМЕННЫЕ ДЛЯ ОБРАБОТКИ ПОТЕРЬ
 *============================================================================*/
static uint8_t lost_frame_counter = 0;  /*!< Счетчик потерянных кадров подряд */

/*============================================================================
 *                      ФУНКЦИИ ЗАДЕРЖКИ
 *============================================================================*/

/**
 * @brief   Микросекундная задержка через NOP инструкции
 * @param   count   Количество циклов NOP
 * @note    Примерно 1 count = 1 такт процессора (для отладки)
 */
void delay_nop(uint32_t count)
{
    for(uint32_t i = 0; i < count; i++)
    {
        __asm("nop"); 
    }
}

/*============================================================================
 *                      ФУНКЦИИ ОТОБРАЖЕНИЯ
 *============================================================================*/

/**
 * @brief   Рисование пунктирной рамки (для индикации потери цели)
 * @param   x       Координата X верхнего левого угла
 * @param   y       Координата Y верхнего левого угла
 * @param   w       Ширина рамки в пикселях
 * @param   h       Высота рамки в пикселях
 * @param   color   Цвет рамки в формате RGB565
 * 
 * @note    Используется для визуализации потери отслеживания объекта
 * @note    Длина штриха - 2 пикселя, пробела - 2 пикселя
 */
void DrawDashedRect(uint16_t x, uint16_t y, uint16_t w, uint16_t h, uint16_t color)
{
    // Верхняя горизонтальная линия (пунктир)
    for (uint16_t i = 0; i < w; i += 4) {
        uint16_t segment = (w - i > 2) ? 2 : (w - i);
        ST7735_LCD_Driver.DrawHLine(&st7735_pObj, x + i, y, segment, color);
    }
    
    // Нижняя горизонтальная линия (пунктир)
    for (uint16_t i = 0; i < w; i += 4) {
        uint16_t segment = (w - i > 2) ? 2 : (w - i);
        ST7735_LCD_Driver.DrawHLine(&st7735_pObj, x + i, y + h, segment, color);
    }
    
    // Левая вертикальная линия (пунктир)
    for (uint16_t i = 0; i < h; i += 4) {
        uint16_t segment = (h - i > 2) ? 2 : (h - i);
        ST7735_LCD_Driver.DrawVLine(&st7735_pObj, x, y + i, segment, color);
    }
    
    // Правая вертикальная линия (пунктир)
    for (uint16_t i = 0; i < h; i += 4) {
        uint16_t segment = (h - i > 2) ? 2 : (h - i);
        ST7735_LCD_Driver.DrawVLine(&st7735_pObj, x + w, y + i, segment, color);
    }
}

/**
 * @brief   Вывод текста поверх видео с фоном
 * @param   x       Координата X начала текста
 * @param   y       Координата Y начала текста
 * @param   text    Указатель на строку для вывода
 * @param   color   Цвет текста в формате RGB565
 * @param   bg      Цвет фона в формате RGB565 (BLACK для прозрачности)
 * 
 * @note    Использует фиксированную ширину символа 6 пикселей
 * @note    Высота символа фиксирована - 12 пикселей
 */
void LCD_ShowTextOverlay(uint16_t x, uint16_t y, char* text, uint16_t color, uint16_t bg)
{
    if (!text) return;
    
    uint8_t char_width = 6;   /*!< Ширина символа в пикселях */
    uint8_t char_height = 12; /*!< Высота символа в пикселях */
    uint16_t text_width = strlen(text) * char_width;
    uint16_t temp_point = POINT_COLOR;
    uint16_t temp_back = BACK_COLOR;
    
    /* Устанавливаем цвета */
    POINT_COLOR = color;
    BACK_COLOR = bg;
    
    /* Рисуем прямоугольник фона (если bg не прозрачный) */
    if (bg != 0xFFFF) {  /* 0xFFFF = TRANSPARENT */
        ST7735_LCD_Driver.FillRect(&st7735_pObj, x, y, text_width, char_height, bg);
    }
    
    /* Выводим текст с правильными параметрами:
       x, y - координаты
       width = text_width - ширина всей строки
       height = char_height - высота области
       size = char_height - размер шрифта (12)
    */
    LCD_ShowString(x, y, text_width, char_height, char_height, (uint8_t*)text);
    
    /* Восстанавливаем цвета */
    POINT_COLOR = temp_point;
    BACK_COLOR = temp_back;
}
/*============================================================================
 *                      ФУНКЦИИ УПРАВЛЕНИЯ СВЕТОДИОДОМ
 *============================================================================*/

/**
 * @brief   Управление встроенным светодиодом (мигание)
 * @param   Hdelay  Длительность горения в миллисекундах
 * @param   Ldelay  Длительность паузы в миллисекундах
 * 
 * @note    Блокирующая функция, использует HAL_Delay
 * @note    Светодиод подключен к пину PE3
 */
void LED_Blink(uint32_t Hdelay, uint32_t Ldelay)
{
    HAL_GPIO_WritePin(PE3_GPIO_Port, PE3_Pin, GPIO_PIN_SET);   /* Включить */
    HAL_Delay(Hdelay);
    HAL_GPIO_WritePin(PE3_GPIO_Port, PE3_Pin, GPIO_PIN_RESET); /* Выключить */
    HAL_Delay(Ldelay);
}

/*============================================================================
 *                      ФУНКЦИИ ТЕСТИРОВАНИЯ ДИСПЛЕЯ
 *============================================================================*/

/**
 * @brief   Вывод тестового паттерна на дисплей
 * @details Рисует три вертикальные полосы (красный, зеленый, синий)
 *          для проверки цветопередачи и работы дисплея
 * 
 * @note    Паттерн отображается в течение 2 секунд
 * @note    После паттерна экран очищается (черный)
 */
void LCD_TestPattern(void)
{
    uint16_t test_buf[LCD_HEIGHT][LCD_WIDTH];
    
    /* Заполнение буфера цветными полосами */
    for(int y = 0; y < LCD_HEIGHT; y++) {
        for(int x = 0; x < LCD_WIDTH; x++) {
            if (x < LCD_WIDTH/3) {
                test_buf[y][x] = RED;      /* Левая треть - красный */
            } else if (x < 2*LCD_WIDTH/3) {
                test_buf[y][x] = GREEN;    /* Средняя треть - зеленый */
            } else {
                test_buf[y][x] = BLUE;     /* Правая треть - синий */
            }
        }
    }
    
    /* Отображение паттерна */
    ST7735_FillRGBRect(&st7735_pObj, 0, 0, (uint8_t *)test_buf, LCD_WIDTH, LCD_HEIGHT);
    HAL_Delay(2000);
    ST7735_LCD_Driver.FillRect(&st7735_pObj, 0, 0, LCD_WIDTH, LCD_HEIGHT, BLACK);
    HAL_Delay(500);
}

/*============================================================================
 *                      ФУНКЦИИ ОБНОВЛЕНИЯ ДИАГНОСТИКИ
 *============================================================================*/

/**
 * @brief   Обновление диагностической информации на дисплее
 * @details Отображает режим работы, FPS, статус детекции и трекинга
 * 
 * @note    Вызывается периодически из основного цикла
 * @note    Информация выводится в верхней части экрана (строки 1-4)
 */
void UpdateDiagnosticDisplay(void)
{
    /* Очистка верхней части дисплея */
    ST7735_LCD_Driver.FillRect(&st7735_pObj, 0, 0, LCD_WIDTH, 60, BLACK);
    
    /* Строка 1: Режим работы и FPS */
    const char* mode_str =  "VIDEO";
    sprintf((char *)line1, "%s FPS:%u", mode_str, (unsigned int)Camera_FPS);
    LCD_ShowString(5, 2, 100, 16, 12, line1);  /* width=100, height=16, size=12 */
    
    /* Строка 2: Размер объекта или статус */
    sprintf((char *)line2, "READY");
    LCD_ShowString(5, 16, 100, 16, 12, line2);  /* width=100, height=16, size=12 */
    
    /* Строка 3: Подсказка по кнопке */
    sprintf((char *)line3, "PRESS KEY");
    LCD_ShowString(5, 30, 100, 16, 12, line3);  /* width=100, height=16, size=12 */
    
    /* Строка 4: Действие */
    sprintf((char *)line4, "START TRACK");
    LCD_ShowString(5, 44, 100, 16, 12, line4);  /* width=100, height=16, size=12 */
}

/*============================================================================
 *                      ФУНКЦИИ ОБРАБОТКИ КНОПКИ
 *============================================================================*/

/**
 * @brief   Обработка нажатия кнопки с антидребезгом
 * @details Переключение режимов работы приложения
 * 
 * @note    Использует BUTTON_DEBOUNCE для подавления дребезга
 * @note    Кнопка подключена с активным низким уровнем (PRESS = 0)
 */
void HandleButton(void)
{
    uint32_t now = HAL_GetTick();
    static uint32_t last_press = 0;
    
    /* Проверка нажатия (активный низкий уровень) */
    if (HAL_GPIO_ReadPin(KEY_GPIO_Port, KEY_Pin) == GPIO_PIN_RESET)
    {
        /* Антидребезг */
        if (now - last_press > BUTTON_DEBOUNCE) {
            last_press = now;
            
            /* Здесь можно добавить переключение режимов */
            // current_mode = (current_mode + 1) % 4;
            
            LED_Blink(50, 50);  /* Визуальное подтверждение */
        }
    }
}

/*============================================================================
 *                      CALLBACK ФУНКЦИИ DCMI
 *============================================================================*/

/**
 * @brief   Callback завершения кадра DCMI (вызывается из прерывания)
 * @param   hdcmi   Указатель на структуру DCMI_HandleTypeDef
 * 
 * @details Выполняет переключение буферов в Ping-Pong режиме:
 *          1. Переключает активный буфер
 *          2. Обновляет указатель DMA на новый буфер
 *          3. Инвалидирует кэш для готового буфера
 *          4. Обновляет счетчик FPS
 *          5. Устанавливает флаг готовности кадра
 * 
 * @note    Вызывается из прерывания - должна быть быстрой
 * @note    Используется двойная буферизация для непрерывного захвата
 */
void HAL_DCMI_FrameEventCallback(DCMI_HandleTypeDef *hdcmi)
{
    static uint32_t count = 0;
    uint32_t current_tick = HAL_GetTick();
    
    /* Переключение буферов */
    if (active_buffer == 0) {
        active_buffer = 1;
        ready_buffer = 0;
        hdcmi->Instance->DR = (uint32_t)pic[1];
    } else {
        active_buffer = 0;
        ready_buffer = 1;
        hdcmi->Instance->DR = (uint32_t)pic[0];
    }
    
    /* Инвалидация кэша для готового буфера (Cortex-M7 с кэшем) */
    SCB_InvalidateDCache_by_Addr((uint32_t*)pic[ready_buffer], FRAME_BUFFER_SIZE);
    
    /* Подсчет FPS */
    count++;
    if (current_tick - LastFPSUpdate >= 1000) {
        Camera_FPS = count;
        count = 0;
        LastFPSUpdate = current_tick;
    }
    
    /* Обновление флагов и счетчиков */
    irq_counter++;
    DCMI_FrameIsReady = 1;
}

/**
 * @brief   Callback ошибки DCMI
 * @param   hdcmi   Указатель на структуру DCMI_HandleTypeDef
 * 
 * @details При возникновении ошибки DMA:
 *          1. Увеличивает счетчик ошибок
 *          2. Останавливает DCMI
 *          3. Перезапускает DMA с текущим активным буфером
 * 
 * @note    Позволяет восстановить захват после временных сбоев
 */
void HAL_DCMI_ErrorCallback(DCMI_HandleTypeDef *hdcmi)
{
    error_counter++;
    
    /* Перезапуск DMA */
    HAL_DCMI_Stop(hdcmi);
    HAL_Delay(10);
    HAL_DCMI_Start_DMA(hdcmi, DCMI_MODE_CONTINUOUS, 
                       (uint32_t)pic[active_buffer], 
                       FrameWidth * FrameHeight);
}


/************************ (C) COPYRIGHT Борисов Руслан *****END OF FILE****/